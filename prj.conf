## CMakeLists.txt
```
cmake_minimum_required(VERSION 3.20.0)
find_package(Zephyr REQUIRED HINTS $ENV{ZEPHYR_BASE})
project(LTE_Http_code_9151)
target_sources(app PRIVATE
    src/main.c
    src/http.c
)
target_include_directories(app PRIVATE
    src
)
```

## Kconfig
```
config HTTP_SAMPLE_HOSTNAME
	string "HTTP server hostname"
	default "rest.nordicsemi.academy"
config HTTP_SAMPLE_PORT
    string "HTTP server port"
    default "80"
config HTTP_URL
	string "Set the url which you are requesting"
    default "06ebb07c-de43-4b3a-8ff4-fd0d83e3e9c0"
endmenu
source "Kconfig.zephyr"
```

## prj.conf
```kconfig
CONFIG_LOG=y
CONFIG_DK_LIBRARY=y

# Network
CONFIG_NETWORKING=y
CONFIG_NET_NATIVE=n
CONFIG_NET_SOCKETS=y
CONFIG_NET_SOCKETS_OFFLOAD=y
CONFIG_POSIX_API=y
# Memory
CONFIG_HEAP_MEM_POOL_SIZE=16384
CONFIG_SYSTEM_WORKQUEUE_STACK_SIZE=4192
CONFIG_MAIN_STACK_SIZE=4096

# Modem library
CONFIG_NRF_MODEM_LIB=y
CONFIG_LTE_LINK_CONTROL=y

# THis is default webhook.site url will expire soon so change this before expire
CONFIG_HTTP_SAMPLE_HOSTNAME="webhook.site"  
CONFIG_HTTP_URL="/545a395d-9878-4d39-965d-2f710d678ebc"
CONFIG_LTE_LC_DNS_FALLBACK_MODULE=y
CONFIG_LTE_LC_DNS_FALLBACK_ADDRESS="2001:67c:2b0::4"
CONFIG_HTTP_CLIENT=y
```

## src/main.c
```c
#include <stdio.h>
#include <ncs_version.h>
#include <zephyr/kernel.h>
#include <zephyr/logging/log.h>
#include <dk_buttons_and_leds.h>
#include <modem/nrf_modem_lib.h>
#include <modem/lte_lc.h>
#include "http.h"
#include <modem/nrf_modem_lib.h>
#include <nrf_modem.h>
#include <nrf_socket.h> 
bool net_connected = false;
int server_connection;
bool ser_flag = 0;
int ser_retry = 0;
uint8_t counter = 0;
static K_SEM_DEFINE(lte_connected, 0, 1);
LOG_MODULE_REGISTER(main_c, LOG_LEVEL_INF);
uint16_t data[32];
char text_data[] = "Hello This is testing of the text sending via HTTP POST ";
void set_manual_dns(void)
{
	int err;
	struct nrf_in6_addr dns_addr = {.s6_addr = {0x20, 0x01, 0x06, 0x7c, 0x02, 0xb0, 0x00, 0x00,
												0x00, 0x00, 0x00, 0x00, 0x00, 0x00, 0x00, 0x04}};

	err = nrf_setdnsaddr(NRF_AF_INET6, &dns_addr, sizeof(dns_addr));
	if (err)
	{
		printk("Failed to set DNS: %d\n", err);
	}
	else
	{
		printk("Manual NAT64 DNS configured successfully!\n");
	}
}
static void lte_handler(const struct lte_lc_evt *const evt)
{
	switch (evt->type)
	{
	case LTE_LC_EVT_NW_REG_STATUS:
		if ((evt->nw_reg_status != LTE_LC_NW_REG_REGISTERED_HOME) &&
			(evt->nw_reg_status != LTE_LC_NW_REG_REGISTERED_ROAMING))
		{
			break;
		}
		LOG_INF("Network registration status: %s",
				evt->nw_reg_status == LTE_LC_NW_REG_REGISTERED_HOME ? "Connected - home network" : "Connected - roaming");
		k_sem_give(&lte_connected);
		dk_set_led_on(DK_LED2);
		break;
	case LTE_LC_EVT_RRC_UPDATE:
		net_connected = 1;
		LOG_INF("RRC mode: %s,%d", evt->rrc_mode == LTE_LC_RRC_MODE_CONNECTED ? "Connected" : "Idle", net_connected);
		break;
	default:
		break;
	}
}
static int modem_configure(void)
{
	int err;

	LOG_INF("Initializing modem library");
	err = nrf_modem_lib_init();
	if (err)
	{
		LOG_ERR("Failed to initialize the modem library, error: %d", err);
		return err;
	}
	set_manual_dns();
	k_msleep(100);
	LOG_INF("Connecting to LTE network");
	err = lte_lc_connect_async(lte_handler);
	if (err)
	{
		LOG_ERR("Error in lte_lc_connect_async, error: %d", err);
		return err;
	}
	return 0;
}

static void button_handler(uint32_t button_state, uint32_t has_changed)
{
	if (has_changed & DK_BTN1_MSK && button_state & DK_BTN1_MSK)
	{
		if (server_connect() >= 0)
		{
			client_http_post_json(data);
			counter++;
		}
	}
	else if (has_changed & DK_BTN2_MSK && button_state & DK_BTN2_MSK)
	{

		if (server_connect() >= 0)
		{
			client_http_post_text(text_data);
			counter++;
		}
	}
}

void lte_Connection()
{
	int err;
	LOG_INF("Initializing the modem....");
	if (dk_leds_init() != 0)
	{
		LOG_ERR("Failed to initialize the LEDs Library");
	}
	else
	{
		LOG_INF("Initialized LEDs");
	}
	err = modem_configure();
	if (err)
	{
		LOG_ERR("Failed to configure the modem");
		return 0;
	}
	else
	{
		LOG_INF("Modem configuration succesful.....");
	}

	k_sem_take(&lte_connected, K_FOREVER);
	LOG_INF("Connected to LTE network");
}

int main(void)
{

	while (1)
	{

		if (net_connected)
		{
			for (int i = 0; i < 20; i++)
			{
				printk("\r%d", i);
				k_msleep(1000);
			}
			if (server_resolve() != 0)
			{
				LOG_ERR("Failed to resolve server name");
			}

			LOG_INF("Connecting to %s:%s", CONFIG_HTTP_SAMPLE_HOSTNAME, CONFIG_HTTP_SAMPLE_PORT);
			if (server_connect() != 0)
			{
				LOG_ERR("Failed to connect to server");
			}
			else
			{
				printk("Server conected");
				dk_set_led_on(DK_LED1);
				break;
			}
		}
		else
		{
			k_msleep(10000);
		}
		LOG_INF("net not connected");
	}
	LOG_INF("Outside network loop");
	data[0] = 1;
	data[1] = 2;
	data[2] = 3;
	data[3] = 4;
	data[4] = 5;
	data[5] = 6;
	for (int j = 0; j < 3; j++)
	{
		client_http_post_json(data);
		k_msleep(1000);
		server_connect();
		client_http_post_text(text_data);
		k_msleep(1000);
		server_connect();
		client_http_put();
		k_msleep(1000);
		server_connect();
		client_http_get();
		k_msleep(1000);
		server_connect();
	}
	return 0;
}

K_THREAD_DEFINE(connection_tread, 4192, lte_Connection, NULL, NULL, NULL, 7, 0, 0);
```

## src/http.c
```c
#include <zephyr/net/socket.h>
#include <zephyr/net/http/client.h>
#include <zephyr/logging/log.h>
#include "http.h"
#define EVENT_MASK (NET_EVENT_L4_CONNECTED | NET_EVENT_L4_DISCONNECTED)
LOG_MODULE_REGISTER(http_c, LOG_LEVEL_INF);


static char recv_buf[RECV_BUF_SIZE];
static char client_id_buf[CLIENT_ID_SIZE + 2];
static int counter = 0;
static int sock;
static struct sockaddr_storage server;
static struct sockaddr_in6 server_addr;
int server_resolve(void)
{
    int err;
    struct addrinfo *result;
    struct addrinfo hints = {
        .ai_family = AF_INET6, 
        .ai_socktype = SOCK_STREAM,
    };
    err = getaddrinfo(CONFIG_HTTP_SAMPLE_HOSTNAME,
                      CONFIG_HTTP_SAMPLE_PORT,
                      &hints,
                      &result);

    if (err != 0 || result == NULL)
    {
        LOG_ERR("getaddrinfo failed, err: %d, %s", err, gai_strerror(err));
        return -EIO;
    }

    memcpy(&server_addr, result->ai_addr, sizeof(struct sockaddr_in6));
    char ipv6_addr[NET_IPV6_ADDR_LEN];
    inet_ntop(AF_INET6, &server_addr.sin6_addr, ipv6_addr, sizeof(ipv6_addr));
    LOG_INF("IPv6 address resolved: %s", ipv6_addr);
    freeaddrinfo(result);
    return 0;
}

int server_connect(void)
{
    int err;
    sock = socket(AF_INET6, SOCK_STREAM, IPPROTO_TCP);

    if (sock < 0)
    {
        LOG_ERR("Failed to create socket: %d", errno);
        return -errno;
    }

    LOG_INF("Connecting to server...");
    err = connect(sock,
                  (struct sockaddr *)&server_addr,
                  sizeof(struct sockaddr_in6));

    if (err < 0)
    {
        LOG_ERR("Connect failed, err: %d, %s", errno, strerror(errno));
        close(sock);
        return -errno;
    }

    LOG_INF("Connected!");
    return 0;
}
static int response_cb(struct http_response *rsp, enum http_final_call final_data, void *user_data)
{
    LOG_INF("Response status: %s", rsp->http_status);
    if (rsp->body_frag_len > 0)
    {
        char body_buf[rsp->body_frag_len];
        strncpy(body_buf, rsp->body_frag_start, rsp->body_frag_len);
        body_buf[rsp->body_frag_len] = '\0';
        LOG_INF("Received: %s", body_buf);
    }
    LOG_INF("Closing socket: %d", sock);
    close(sock);
    return 0;
}

static int client_id_cb(struct http_response *rsp, enum http_final_call final_data,
                        void *user_data)
{
    LOG_INF("Response status: %s", rsp->http_status);
    char client_id_buf_tmp[CLIENT_ID_SIZE + 1];
    strncpy(client_id_buf_tmp, rsp->body_frag_start, CLIENT_ID_SIZE);
    client_id_buf_tmp[CLIENT_ID_SIZE] = '\0';
    client_id_buf[0] = '/';
    strcat(client_id_buf, client_id_buf_tmp);

    LOG_INF("Successfully acquired client ID: %s", client_id_buf);

    LOG_INF("Closing socket: %d", sock);
    close(sock);
    return 0;
}

int client_http_post_json(int16_t data[])
{
    int err = 0;
    int bytes_written;
    struct http_request req;
    memset(&req, 0, sizeof(req));
    static char buffer[512];
    static char content_length[32];
    static const char *headers[] = {
        "Content-Type: application/json\r\n",
        content_length,
        "Connection: close\r\n",
        NULL};
    bytes_written = snprintf(buffer, sizeof(buffer), "{\n\"x\": %u,\n\"y\":%u,\n\"z\":%u,\n}", data[0], data[1], data[2]);
    if (bytes_written < 0)
    {
        LOG_INF("Unable to write to buffer, err: %d", bytes_written);
        return bytes_written;
    }
    snprintf(content_length, sizeof(content_length), "Content-Length: %d\r\n", bytes_written);

    req.header_fields = headers;
    req.method = HTTP_POST;
    req.url = CONFIG_HTTP_URL; 
    req.host = CONFIG_HTTP_SAMPLE_HOSTNAME;
    req.protocol = "HTTP/1.1";
    req.payload = buffer;
    req.payload_len = bytes_written;
    req.response = response_cb;
    req.recv_buf = recv_buf;
    req.recv_buf_len = sizeof(recv_buf);
    LOG_INF("HTTP POST request: %s", buffer);
    err = http_client_req(sock, &req, 5000, NULL);
    if (err < 0)
    {
        LOG_ERR("Failed to send HTTP POST request %s, err: %d", buffer, err);
    }
    return err;
}

int client_http_post_text(char text_data[])
{
    int err = 0;
    int bytes_written;
    struct http_request req;
    memset(&req, 0, sizeof(req));
    static char buffer[1024];
    static char content_length[32];

    const char *headers[] = {
        "Content-Type: text/plain\r\n", 
        content_length,                
        "Connection: close\r\n",
        NULL};
    strcpy(buffer, text_data);
    bytes_written = strlen(buffer);
    if (bytes_written < 0)
    {
        LOG_INF("Unable to write to buffer, err: %d", bytes_written);
        return bytes_written;
    }
    req.header_fields = headers;
    req.method = HTTP_POST;
    req.url = CONFIG_HTTP_URL;
    req.host = CONFIG_HTTP_SAMPLE_HOSTNAME;
    req.protocol = "HTTP/1.1";
    req.payload = buffer;
    req.payload_len = bytes_written;
    req.response = response_cb;
    req.recv_buf = recv_buf;
    req.recv_buf_len = sizeof(recv_buf);
    LOG_INF("HTTP POST request: %s", buffer);
    err = http_client_req(sock, &req, 5000, NULL);
    if (err < 0)
    {
        LOG_ERR("Failed to send HTTP POST request %s, err: %d", buffer, err);
    }

    return err;
}

int client_http_put(void)
{
    int err = 0;
    int bytes_written;
    struct http_request req;
    memset(&req, 0, sizeof(req));
    static char content_length[32];
    static char buffer[512];
    static const char *headers[] = {
        "Content-Type: application/json\r\n",
        content_length,
        "Connection: close\r\n",
        NULL};
    bytes_written = snprintf(buffer, sizeof(buffer), "{\"counter\": %d}", counter);
    if (bytes_written < 0)
    {
        LOG_INF("Unable to write to buffer, err: %d", bytes_written);
        return bytes_written;
    }
    snprintf(content_length, sizeof(content_length), "Content-Length: %d\r\n", bytes_written);
    req.header_fields = headers;
    req.method = HTTP_PUT;
    req.url = CONFIG_HTTP_URL;
    req.host = CONFIG_HTTP_SAMPLE_HOSTNAME;
    req.protocol = "HTTP/1.1";
    req.payload = buffer;
    req.payload_len = bytes_written;
    req.response = response_cb;
    req.recv_buf = recv_buf;
    req.recv_buf_len = sizeof(recv_buf);

    LOG_INF("HTTP PUT request: %s", buffer);
    err = http_client_req(sock, &req, 5000, NULL);
    if (err < 0)
    {
        LOG_ERR("Failed to send HTTP PUT request %s, err: %d", buffer, err);
    }
    counter++;
    return err;
}

int client_http_get(void)
{
    int err = 0;
    struct http_request req;
    memset(&req, 0, sizeof(req));
    const char *headers[] = {"Connection: close\r\n", NULL};
    req.header_fields = headers;
    req.method = HTTP_GET;
    req.url = CONFIG_HTTP_URL;
    req.host = CONFIG_HTTP_SAMPLE_HOSTNAME;
    req.protocol = "HTTP/1.1";
    req.response = response_cb;
    req.recv_buf = recv_buf;
    req.recv_buf_len = sizeof(recv_buf);
    /* Send the GET request to the server */
    LOG_INF("HTTP GET request");
    err = http_client_req(sock, &req, 5000, NULL);
    if (err < 0)
    {
        LOG_ERR("Failed to send HTTP GET request, err: %d", err);
    }
    return err;
}

int client_get_new_id(void)
{
    int err = 0;
    struct http_request req;
    memset(&req, 0, sizeof(req));
    const char *headers[] = {"Connection: close\r\n", NULL};
    req.header_fields = headers;
    req.method = HTTP_POST;
    req.url = CONFIG_HTTP_URL;
    req.host = CONFIG_HTTP_SAMPLE_HOSTNAME;
    req.protocol = "HTTP/1.1";
    req.response = client_id_cb;
    req.recv_buf = recv_buf;
    req.recv_buf_len = sizeof(recv_buf);
    LOG_INF("HTTP POST request");
    err = http_client_req(sock, &req, 5000, NULL);
    if (err < 0)
    {
        LOG_ERR("Failed to send HTTP POST request, err: %d", err);
    }
    return err;
}
```

## src/http.h
```c
#ifndef HTTP_CLIENT_APP_H_
#define HTTP_CLIENT_APP_H_

#include <stdint.h>
#define RECV_BUF_SIZE 2048
#define CLIENT_ID_SIZE 36
int server_resolve(void);
int server_connect(void);
int client_http_post_json(int16_t data[]);
int client_http_post_text(char text_data[]);
int client_http_put(void);
int client_http_get(void);
int client_get_new_id(void);

#endif /* HTTP_CLIENT_APP_H_ */
```
